## boards/sg200x/sg2002_milkv_duo256m_arm_sd/sg2002_milkv_duo256m_arm_sd_defconfig
```kconfig
CONFIG_CHIP_sg2002=y
CONFIG_BOARD_milkv_duo256m_arm_sd=y
CONFIG_BOARD="milkv_duo256m_arm_sd"
CONFIG_DDR_CFG_ddr3_1866_x16=y
CONFIG_ARCH="arm"

CONFIG_CROSS_COMPILE_KERNEL="arm-linux-gnueabihf-"
CONFIG_CC_OPTIMIZE_FOR_SIZE=y
CONFIG_KERNEL_ENTRY_HACK=y
CONFIG_KERNEL_ENTRY_HACK_ADDR="0x80108000"

CONFIG_TOOLCHAIN_GLIBC_ARM=y
CONFIG_FLASH_SIZE_SHRINK=y
CONFIG_BOOT_IMAGE_SINGLE_DTB=y

CONFIG_STORAGE_TYPE_sd=y
CONFIG_STORAGE_TYPE="sd"

CONFIG_SENSOR_GCORE_GC2053=y
CONFIG_SENSOR_GCORE_GC2053_1L=y
CONFIG_SENSOR_GCORE_GC2093=y
CONFIG_SENSOR_GCORE_GC4653=y

CONFIG_UBOOT_2021_10=y
CONFIG_UBOOT_SRC="u-boot-2021.10"

CONFIG_KERNEL_SRC_5.10=y
CONFIG_KERNEL_SRC="linux_5.10"
CONFIG_KERNEL_LZMA=y
CONFIG_KERNEL_COMPRESS="lzma"

CONFIG_SKIP_RAMDISK=y
CONFIG_USE_4K_ERASE_SIZE_FOR_JFFS2=y

# CONFIG_ROOTFS_OVERLAYFS is not set
CONFIG_TARGET_PACKAGE_DROPBEAR=y
CONFIG_TARGET_PACKAGE_MTD-UTILS=y
# CONFIG_TARGET_PACKAGE_RSYSLOG is not set
# CONFIG_TARGET_PACKAGE_GATORD is not set
```
